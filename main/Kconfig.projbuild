## main/Kconfig.projbuild
```kconfig
menu "OpenClaw Client Configuration"

    config OPENCLAW_WIFI_SSID
        string "WiFi SSID"
        default "MyWiFiNetwork"
        help
            SSID (Network Name) of the Wi-Fi AP to connect to.

    config OPENCLAW_WIFI_PASSWORD
        string "WiFi Password"
        default "MySecretPassword"
        help
            Password for the Wi-Fi network.

    config OPENCLAW_ENDPOINT_URL
        string "OpenClaw Voice Endpoint URL"
        default "http://192.168.1.100:18790/voice"
        help
            The complete HTTP URL of the Jarvis Bridge / OpenClaw voice ingestion endpoint.

endmenu
```

## sdkconfig.defaults
```kconfig
CONFIG_ESPTOOLPY_FLASHMODE_QIO=y
CONFIG_ESPTOOLPY_FLASHFREQ_80M=y
CONFIG_SPIRAM=y
CONFIG_SPIRAM_MODE_OCT=y
CONFIG_SPIRAM_SPEED_80M=y
CONFIG_SPIRAM_USE_MALLOC=y
CONFIG_SPIRAM_MALLOC_ALWAYSINTERNAL=16384

CONFIG_PARTITION_TABLE_CUSTOM=y
CONFIG_PARTITION_TABLE_CUSTOM_FILENAME="partitions.csv"
CONFIG_PARTITION_TABLE_FILENAME="partitions.csv"
CONFIG_PARTITION_TABLE_OFFSET=0x8000
CONFIG_PARTITION_TABLE_MD5=y


CONFIG_ESPTOOLPY_FLASHSIZE_16MB=y
CONFIG_ESPTOOLPY_FLASHSIZE="16MB"

# OpenClaw Defaults
CONFIG_OPENCLAW_WIFI_SSID="YOUR_WIFI_SSID"
CONFIG_OPENCLAW_WIFI_PASSWORD="YOUR_WIFI_PASSWORD"
CONFIG_OPENCLAW_ENDPOINT_URL="http://192.168.1.100:18790/voice"
```
